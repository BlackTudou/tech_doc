Data.Set SD:0x802040 %LE %Long 0
Data.Set SD:0x802044 %LE %Long 0